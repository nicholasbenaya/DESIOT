## firmware_idf/sdkconfig.defaults
```kconfig
# Bluetooth Stack Configuration
CONFIG_BT_ENABLED=y
CONFIG_BT_BLUEDROID_ENABLED=y
CONFIG_BT_BLE_ENABLED=y
CONFIG_BT_BLE_42_FEATURES_SUPPORTED=y
CONFIG_BT_BLE_50_FEATURES_SUPPORTED=n
CONFIG_BT_BTU_TASK_STACK_SIZE=4512

# Partition Table Configuration (4MB Custom Partition for 8MB ESP32-S3 Flash)
CONFIG_PARTITION_TABLE_CUSTOM=y
CONFIG_PARTITION_TABLE_CUSTOM_FILENAME="partitions.csv"
CONFIG_PARTITION_TABLE_FILENAME="partitions.csv"
CONFIG_ESPTOOLPY_FLASHSIZE_8MB=y
CONFIG_ESPTOOLPY_FLASHSIZE="8MB"

# BLE Mesh Base Configuration
CONFIG_BLE_MESH=y
CONFIG_BLE_MESH_NODE=y
CONFIG_BLE_MESH_PB_ADV=y
CONFIG_BLE_MESH_PB_GATT=y
CONFIG_BLE_MESH_TX_SEG_MSG_COUNT=10
CONFIG_BLE_MESH_RX_SEG_MSG_COUNT=10
CONFIG_BLE_MESH_CFG_CLI=y

# Node 3: Relay & Friend Capabilities
CONFIG_BLE_MESH_RELAY=y
CONFIG_BLE_MESH_FRIEND=y
CONFIG_BLE_MESH_FRIEND_LPN_COUNT=2
CONFIG_BLE_MESH_FRIEND_QUEUE_SIZE=16
CONFIG_BLE_MESH_FRIEND_RECV_WIN=20

# Node 1: Generic Server
CONFIG_BLE_MESH_GENERIC_SERVER=y

# Node 2: Low Power Node
CONFIG_BLE_MESH_LOW_POWER=y
CONFIG_BLE_MESH_LPN_AUTO=y

# Node 4: Provisioner & Coexistence
CONFIG_BLE_MESH_PROVISIONER=y
CONFIG_BLE_MESH_GENERIC_ONOFF_CLI=y
CONFIG_ESP_COEX_SW_COEXIST_ENABLE=y
```
